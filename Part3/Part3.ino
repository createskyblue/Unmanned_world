#include <Arduboy2.h>
Arduboy2 arduboy;
#include <ArduboyTones.h>
ArduboyTones sound(arduboy.audio.enabled);
#include <EEPROM.h>
/*=========================================================
                         变量
  =========================================================*/
bool DisplayInvert = false;
unsigned long Timer[5];  //0-标题
int PPTX, PPTY;
/*=========================================================
                         常量
  =========================================================*/
#define mobile_frame_time 150
#define key_cool_time 20
/*=========================================================
                         图片
  =========================================================*/
const uint8_t title[] PROGMEM = {
  0xfe, 0x55, 0xab, 0x7e, 0x80, 0x80, 0x80, 0x7e, 0xab, 0x55, 0xfe, 0x00,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 0xff,
  0x00, 0x01, 0x02, 0x05, 0x06, 0x05, 0x06, 0x05, 0x02, 0x01, 0x00, 0x00,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 0x07,
  0x00, 0x00, 0x00, 0x00, 0x00, 0x00, 0x00, 0x00, 0x00, 0x00, 0x00, 0x00,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 0x00,
  0x00, 0x00, 0x00, 0x00, 0x00, 0x00, 0x00, 0x00, 0x00, 0x00, 0x00, 0x00,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 0x00,
};
const uint8_t PROGMEM cg1[] =
{
  0xff, 0xff, 0xff, 0xff, 0xff, 0xff, 0xff, 0xff, 0xff, 0xff, 0xff, 0xff,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 0xff
};
const uint8_t PROGMEM cg2[] =
{
  0x00, 0x00, 0x00, 0x00, 0x00, 0x00, 0x00, 0x7f, 0xff, 0xff, 0xff, 0xff,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 0x00
};
const uint8_t PROGMEM cg3[] =
{
  0xff, 0xf0, 0x0f, 0xff, 0xff, 0xff, 0xc0, 0x07, 0xff, 0xff, 0xff, 0x80,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 0x01
};
const uint8_t Block_37[] PROGMEM = {
  0xfe, 0x01, 0x01, 0x0f, 0x11, 0x11, 0x11, 0x11, 0x11, 0x15, 0x11, 0x0f, 0x01, 0x02, 0x04, 0xf8,
  0x7f, 0x80, 0xfe, 0x81, 0x81, 0x95, 0x95, 0x95, 0x95, 0x95, 0x95, 0x81, 0x81, 0xfe, 0x80, 0x7f,
};
/*=========================================================
                         音乐
  =========================================================*/
const uint16_t sound1[] PROGMEM = {
  262, 480,
  392, 480,
  330, 480,
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  392, 480,
  TONES_END
};
const uint16_t sound2[] PROGMEM = {
  294, 440,
  587, 440,
  497, 440,
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  988, 440,
  TONES_END
};
/*=========================================================
                          字库
        https://github.com/emutyworks/8x8DotJPFont/
  =========================================================*/

#define MISAKI_FONT_F2_H
#define MISAKI_FONT_F2_PAGE 0xF2
#define MISAKI_FONT_F2_W 7
#define MISAKI_FONT_F2_SIZE 0x2F
PROGMEM const uint8_t misaki_font_f2[ MISAKI_FONT_F2_SIZE + 1 ][ MISAKI_FONT_F2_W ] =
{
  { 0x2a, 0x75, 0x21, 0x1f, 0x75, 0x37, 0x71 }, /* 0x00 編 */
  { 0x35, 0x7f, 0x44, 0x57, 0x7d, 0x57, 0x44 }, /* 0x01 程 */
  { 0x52, 0x56, 0x57, 0x3e, 0x56, 0x57, 0x52 }, /* 0x02 美 */
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  { 0x00, 0x00, 0x00, 0x00, 0x00, 0x00, 0x00 },
};
/*=========================================================
                          中文对话
  =========================================================*/
PROGMEM const uint8_t misaki_font_0x00[1] = { 0x00 };
PROGMEM const uint8_t mes0[] = { 0xf2, 0x00, 0x01, 0x2f, 0x02, 0x03, 0x2f, 0x04, 0x05, }; //編程 美術 策劃
PROGMEM const uint8_t mes1[] = { 0xf2, 0x06, 0x07, 0x08, 0x09, }; //束負浩文
PROGMEM const uint8_t mes2[] = { 0xf2, 0x0a, 0x0b, 0x0c, 0x0d, 0x0e, 0x0f, 0x10, 0x11, }; //玄不代表冷酷無情
PROGMEM const uint8_t mes3[] = { 0xf2, 0x12, 0x13, 0x14, 0x15, 0x16, 0x0e, 0x0f, 0x17, 0x18, 0x19, }; //相對於這個冷酷的世界
PROGMEM const uint8_t mes4[] = { 0xf2, 0x1a, 0x17, 0x18, 0x19, 0x1b, 0x1c, 0x1d, 0x1a, }; //我的世界暖和著我
PROGMEM const uint8_t mes5[] = { 0xf2, 0x1e, 0x1f, 0x20, 0x21, 0x22, 0x23, 0x1a, }; //感謝壹路陪伴我
PROGMEM const uint8_t mes6[] = { 0xf2, 0x24, 0x1a, 0x25, 0x26, 0x27, 0x28, 0x29, 0x2a, }; //給我指明歸家方向
PROGMEM const uint8_t mes7[] = { 0xf2, 0x1a, 0x2b, 0x2c, 0x2d, 0x12, 0x2e, }; //我們還會相見
/*====================================================================
                             只循环一次
  ====================================================================*/
void setup()
{
  arduboy.boot();
  SetTextColor(0);
  arduboy.invert(DisplayInvert);
  //Serial.begin(115200);
  arduboy.audio.on();
  sound.tones(sound1);
  //Eload();
}
/*====================================================================
                             主程序
  ====================================================================*/
void loop()
{
  draw();
  if (millis() > 60000) {
    sound.tones(sound2);
    while (1) {}
  }
}

/*
   场景虚化
*/
void Blur(int sx, int sy, int ex, int ey, byte f) {
  for (byte y = 0; y < 64; y++) {
    for (byte x = 0; x < 128; x++) {
      if (x % 2 == y % 2 && x % 2 == 0 && x >= sx && x <= ex && y >= sy && y <= ey) arduboy.drawPixel(x + (f > 0 && f < 3), y + (f > 1), 0);
    }
  }
}
/*=========================================================
                     绘图
  =========================================================*/
void draw()
{
  arduboy.clear();
  if (millis() > 3191 && millis() < 10000 && millis() >= 100 + Timer[0]) {
    Timer[0] = millis();
    PPTY++;
  }
  if (millis() < 8682) {
    arduboy.drawBitmap(16, 16 - PPTY, title, 90, 25, 1);
    drawText(32, 46 - PPTY, mes0, sizeof(mes0));
    drawText(48, 57 - PPTY, mes1, sizeof(mes1));
  }
  if (millis() > 8682 && millis() < 14486) arduboy.drawSlowXYBitmap(0, 0, cg1, 128, 64, 1); //cg1
  if (millis() > 8682  && millis() < 10911 ) Blur(0, 0, 128, 64, 0);
  if (millis() > 8682  && millis() < 12966 ) Blur(0, 0, 128, 64, 1);
  if (millis() > 16639  && millis() < 24294 ) drawText(8, 9, mes2, sizeof(mes2));
  if (millis() > 18423  && millis() < 24294 ) drawText(8, 24, mes3, sizeof(mes3));
  if (millis() > 21321  && millis() < 24294 ) drawText(8, 40, mes4, sizeof(mes4));
  if (millis() > 24295  && millis() < 36100 ) arduboy.drawSlowXYBitmap(0, 0, cg2, 128, 64, 1); //cg2
  if (millis() > 36536) arduboy.drawSlowXYBitmap(88, 3, cg3, 40, 57, 1); //cg4
  if (millis() > 43675) drawText(0, 9, mes5, sizeof(mes5));
  if (millis() > 45426) drawText(0, 24, mes6, sizeof(mes6));
  if (millis() > 47368) drawText(0, 40, mes7, sizeof(mes7));
  arduboy.display();
}

void drawText(uint8_t x, uint8_t y, const uint8_t *mes, uint8_t cnt)
{
  uint8_t pb;
  uint8_t page;
  uint8_t screen_start = 0;
  uint8_t screen_end = 128;
  if (x < screen_start) {
    x = screen_start;
  }
  for (uint8_t i = 0; i < cnt; i++) {
    pb = pgm_read_byte_near(mes + i);
    page = MISAKI_FONT_F2_PAGE;
    if (!page) {
      continue;
    }
    arduboy.fillRect(x, y - 1, 8, 9, 1); //白底
    if (pb > MISAKI_FONT_F2_SIZE) {
      continue;
    }
    if ((x + 8) > screen_end) {
      x = screen_start;
      y = y + 8;
    }
    arduboy.drawBitmap(x, y,  misaki_font_f2[ pb ], MISAKI_FONT_F2_W, 8, 0);
    arduboy.drawBitmap(x + 7, y, misaki_font_0x00, 1, 8, 0);
    x = x + 8;
    if ((x + 8) > screen_end) {
      x = screen_start;
      y = y + 8;
    }
  }
}
void SetTextColor(bool color) {
  arduboy.setTextColor(color);
  arduboy.setTextBackground(!color);
}
void Eload() {
  if (EEPROM.read(512) != 3 ) {
    UpdateROM();
  }
}
/*
   提示更新固件
*/
void UpdateROM() {
  arduboy.clear();
  //arduboy.invert(1);
  arduboy.fillRect(0, 0, 128, 64, 1);
  arduboy.drawBitmap(55, 7, Block_37, 16, 16, 0);
  arduboy.setCursor(4, 39);
  arduboy.print(F("Please upload Part"));
  arduboy.setCursor(120, 39);
  arduboy.print(EEPROM.read(512));
  arduboy.display();
  while (1) {}
}
