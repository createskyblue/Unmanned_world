#include <Arduboy2.h>
Arduboy2 arduboy;
#include <ArduboyTones.h>
ArduboyTones sound(arduboy.audio.enabled);
#include <EEPROM.h>
/*=========================================================
                         变量
  =========================================================*/
bool DisplayInvert = false;
unsigned long Timer[5];  //0-标题
int PPTX, PPTY;
/*=========================================================
                         常量
  =========================================================*/
#define mobile_frame_time 150
#define key_cool_time 20
/*=========================================================
                         图片
  =========================================================*/
const uint8_t title[] PROGMEM = {
  0xfe, 0x55, 0xab, 0x7e, 0x80, 0x80, 0x80, 0x7e, 0xab, 0x55, 0xfe, 0x00,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 0xff,
  0x00, 0x01, 0x02, 0x05, 0x06, 0x05, 0x06, 0x05, 0x02, 0x01, 0x00, 0x00,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 0x07,
  0x00, 0x00, 0x00, 0x00, 0x00, 0x00, 0x00, 0x00, 0x00, 0x00, 0x00, 0x00,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 0x00,
  0x00, 0x00, 0x00, 0x00, 0x00, 0x00, 0x00, 0x00, 0x00, 0x00, 0x00, 0x00,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 0x00,
};
const uint8_t PROGMEM cg1[] =
{
  0x00,0x00,0x00,0x00,0x00,0x00,0x00,0x00,0x00,0x00,0x00,0x00,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0x00
};
const uint8_t PROGMEM cg2[] =
{
  0x00, 0x00, 0x00, 0x00, 0x00, 0x00, 0x00, 0x7f, 0xff, 0xff, 0xff, 0xff,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 0x00
};
const uint8_t PROGMEM cg3[] =
{
  0xff, 0xf0, 0x0f, 0xff, 0xff, 0xff, 0xc0, 0x07, 0xff, 0xff, 0xff, 0x80,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 0x01
};
const uint8_t Block_37[] PROGMEM = {
  0xfe, 0x01, 0x01, 0x0f, 0x11, 0x11, 0x11, 0x11, 0x11, 0x15, 0x11, 0x0f, 0x01, 0x02, 0x04, 0xf8,
  0x7f, 0x80, 0xfe, 0x81, 0x81, 0x95, 0x95, 0x95, 0x95, 0x95, 0x95, 0x81, 0x81, 0xfe, 0x80, 0x7f,
};
/*=========================================================
                         音乐
  =========================================================*/
const uint16_t sound1[] PROGMEM = {
  262, 480,
  392, 480,
  330, 480,
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  392, 480,
  TONES_END
};
const uint16_t sound2[] PROGMEM = {
  294, 440,
  587, 440,
  497, 440,
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  988, 440,
  TONES_END
};
/*====================================================================
                             只循环一次
  ====================================================================*/
void setup()
{
  arduboy.boot();
  SetTextColor(0);
  arduboy.invert(DisplayInvert);
  //Serial.begin(115200);
  arduboy.audio.on();
  sound.tones(sound1);
  //Eload();
}
/*====================================================================
                             主程序
  ====================================================================*/
void loop()
{
  draw();
  if (millis() > 60000) {
    sound.tones(sound2);
    while (1) {}
  }
}
/*
   场景虚化
*/
void Blur(int sx, int sy, int ex, int ey, byte f) {
  for (byte y = 0; y < 64; y++) {
    for (byte x = 0; x < 128; x++) {
      if (x % 2 == y % 2 && x % 2 == 0 && x >= sx && x <= ex && y >= sy && y <= ey) arduboy.drawPixel(x + (f > 0 && f < 3), y + (f > 1), 0);
    }
  }
}
/*=========================================================
                     绘图
  =========================================================*/
void draw()
{
  arduboy.clear();
  if (millis() > 3191 && millis() < 10000 && millis() >= 100 + Timer[0]) {
    Timer[0] = millis();
    PPTY++;
  }
  if (millis() < 8682) {
    arduboy.drawBitmap(16, 16 - PPTY, title, 90, 25, 1);
	arduboy.setCursor(12,46 - PPTY);
	arduboy.println(F(" Programming Art "));
	arduboy.setCursor(42,57 - PPTY);
	arduboy.println(F(" LHW "));
  }
  if (millis() > 8682 && millis() < 14486) arduboy.drawSlowXYBitmap(0, 0, cg1, 128, 64, 1); //cg1
  if (millis() > 8682  && millis() < 10911 ) Blur(0, 0, 128, 64, 0);
  if (millis() > 8682  && millis() < 11639 ) Blur(0, 0, 128, 64, 1);
  if (millis() > 16639  && millis() < 24294 ) {
	  SetTextColor(1);
	  arduboy.setCursor(0,1);
	  arduboy.println(F("XUAN does not stand\nfor ruthlessness"));
  }
  if (millis() > 18423  && millis() < 24294 ) {
	  arduboy.setCursor(0,24);
      arduboy.println(F("To the cold world"));
  }
  if (millis() > 21321  && millis() < 24294 ) {
	  arduboy.setCursor(0,40);
      arduboy.println(F("My world warms me"));
  }
  if (millis() > 24295  && millis() < 36100 ) arduboy.drawSlowXYBitmap(0, 0, cg2, 128, 64, 1); //cg2
  if (millis() > 36536) arduboy.drawSlowXYBitmap(88, 3, cg3, 40, 57, 1); //cg4
  if (millis() > 43675) {
	  arduboy.setCursor(0,1);
      arduboy.println(F("Thanks for\naccompanying me"));
  }
  if (millis() > 45426) {
	  arduboy.setCursor(0,24);
      arduboy.println(F("Show me the\nway home"));
  }
  if (millis() > 47368) {
	  arduboy.setCursor(0,48);
      arduboy.println(F("We'll meet\nagain"));
  }
  arduboy.display();
}
void SetTextColor(bool color) {
  arduboy.setTextColor(color);
  arduboy.setTextBackground(!color);
}
void Eload() {
  if (EEPROM.read(512) != 3 ) {
    UpdateROM();
  }
}
/*
   提示更新固件
*/
void UpdateROM() {
  arduboy.clear();
  //arduboy.invert(1);
  arduboy.fillRect(0, 0, 128, 64, 1);
  arduboy.drawBitmap(55, 7, Block_37, 16, 16, 0);
  arduboy.setCursor(4, 39);
  arduboy.print(F("Please upload Part"));
  arduboy.setCursor(120, 39);
  arduboy.print(EEPROM.read(512));
  arduboy.display();
  while (1) {}
}
